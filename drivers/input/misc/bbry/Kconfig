## drivers/input/misc/bbry/Kconfig
```kconfig
#
# Input misc drivers configuration
#
config STMVL6180
	tristate "STM VL6180 Proximity support"
	depends on I2C=y && SENSOR_EXTENDED
	default y
	help
	  Say Y here if you want to use STMicroelectronics's proximity sensor
	  through I2C interface.

	  To compile this driver as a module, choose M here: the
	  module will be called stmvl6180.

config M4_HUB
	tristate "M4 hub support"
	depends on I2C=y
	default y
	help
	  Say Y here if you want to use the m4 hub interface

	  To compile this driver as a module, choose M here: the
	  module will be called m4_hub

config SENSOR_EXTENDED
	tristate "Extended sensor class support"
	depends on SENSORS
	default y
	help
	  Say Y here if you want to use the extended sensor class interface

	  To compile this driver as a module, choose M here: the
	  module will be called sensor_extended
```

## drivers/staging/bbry/Kconfig
```kconfig
config BBRY_HWFEATURES
	bool "Add sysfs entry from device tree hwfeature attribute"
	default n
	---help---
	help
	  If unsure, say N.
```
