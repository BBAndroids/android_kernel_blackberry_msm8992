/* Copyright (C) 2014 BlackBerry Limited. All rights reserved.
 * Copyright (c) 2013, The Linux Foundation. All rights reserved.
 *
 * This program is free software; you can redistribute it and/or modify
 * it under the terms of the GNU General Public License version 2 and
 * only version 2 as published by the Free Software Foundation.
 *
 * This program is distributed in the hope that it will be useful,
 * but WITHOUT ANY WARRANTY; without even the implied warranty of
 * MERCHANTABILITY or FITNESS FOR A PARTICULAR PURPOSE.  See the
 * GNU General Public License for more details.
 */

/*---------------------------------------------------------------------------
 * This file is autogenerated file using gcdb parser. Please do not edit it.
 * Update input XML file to add a new entry or update variable in this file
 * VERSION = "1.0"
 *---------------------------------------------------------------------------*/
&mdss_mdp {
	dsi_logan_wqhd_cmd_0: qcom,mdss_dsi_logan_wqhd_dualmipi0_cmd {
		qcom,mdss-dsi-panel-name = "Logan WQHD dual0 cmd mode dsi panel";
		oem,mdss-dsi-bbry-lcd-id-class = <53>; /* Logan */
		oem,mdss-dsi-bbry-lcd-id-mfg = <19>; /* SDC */
		qcom,cont-splash-enabled;
		qcom,mdss-dsi-panel-controller = <&mdss_dsi0>;
		qcom,mdss-dsi-panel-type = "dsi_cmd_mode";
		qcom,mdss-dsi-panel-destination = "display_1";
		qcom,mdss-dsi-panel-framerate = <60>;
		qcom,mdss-dsi-panel-clockrate = <830000000>;
		qcom,mdss-dsi-stream = <0>;
		qcom,mdss-dsi-panel-width = <720>;
		qcom,mdss-dsi-panel-height = <2560>;
		qcom,mdss-pan-physical-width-dimension = <68>;  /* (1440 px / 68mm) * 25.4 mm/inch = 537.9 px/inch */
		qcom,mdss-pan-physical-height-dimension = <121>; /* (2560 px / 121mm) * 25.4 mm/inch = 537.3 px/inch */
		qcom,mdss-dsi-h-front-porch = <30>;
		qcom,mdss-dsi-h-back-porch = <14>;
		qcom,mdss-dsi-h-pulse-width = <10>;
		qcom,mdss-dsi-h-sync-skew = <0>;
		qcom,mdss-dsi-v-back-porch = <1>;
		qcom,mdss-dsi-v-front-porch = <7>;
		qcom,mdss-dsi-v-pulse-width = <8>;
		qcom,mdss-dsi-h-left-border = <0>;
		qcom,mdss-dsi-h-right-border = <0>;
		qcom,mdss-dsi-v-top-border = <0>;
		qcom,mdss-dsi-v-bottom-border = <0>;
		qcom,mdss-dsi-bpp = <24>;
		qcom,mdss-dsi-underflow-color = <0xff>;
		qcom,mdss-dsi-border-color = <0>;
		qcom,mdss-dsi-on-command = [
				/* exit sleep mode */
				05 01 00 01 05 00 01 11
				/* Unlock level 2 commands */
				39 01 00 00 00 00 03 f0 5a 5a
				/* Configure dual-dsi link*/
				39 01 00 00 78 00 02 f2 63
				/* enable_te */
				39 01 00 00 00 00 02 35 00
				/* ??? */
				39 01 00 00 00 00 02 b4 00
				/* ??? */
				39 01 00 00 00 00 02 c0 00
				/* acl_enable_disable_settings */
				39 01 00 00 00 00 02 55 02
				/* Lock level 2 commands */
				39 01 00 00 00 00 03 f0 a5 a5
				/* display on */
				05 01 00 01 0a 00 01 29
				];
		qcom,mdss-dsi-off-command = [
				/* display_off */
				05 01 00 00 78 00 01 28
				/* enter sleep mode */
				05 01 00 00 78 00 01 10
				];
		qcom,mdss-dsi-on-command-state = "dsi_lp_mode";
		qcom,mdss-dsi-off-command-state = "dsi_hs_mode";
		oem,mdss-dsi-on-to-lpm-command = [
				/* display_off */
				05 01 00 00 17 00 01 28
				/* Unlock level 2 commands */
				39 01 00 00 00 00 03 f0 5a 5a
				/* disp_ctrl */
				39 01 00 00 00 00 02 53 22
				/* Set index for P9 */
				39 01 00 00 00 00 02 B0 05
				/* ??? */
				39 01 00 00 00 00 04 BB 4D 42 5C    /* Set lowest brightness (10 nits) */
				/* gamma/aor update */
				39 01 00 00 01 00 02 f7 03
				/* ??? */
				39 01 00 00 00 00 02 f7 00
				/* Lock level 2 commands */
				39 01 00 00 00 00 03 f0 a5 a5
				/* display on */
				05 01 00 00 00 00 01 29
				];
		oem,mdss-dsi-on-to-lpm-command-state = "dsi_hs_mode";
		oem,mdss-dsi-lpm-to-on-command = [
				/* display_off */
				05 01 00 00 17 00 01 28
				/* Unlock level 2 commands */
				39 01 00 00 00 00 03 f0 5a 5a
				/* disp_ctrl */
				39 01 00 00 00 00 02 53 00
				/* gamma/aor update */
				39 01 00 00 01 00 02 f7 03
				/* ??? */
				39 01 00 00 00 00 02 f7 00
				/* Lock level 2 commands */
				39 01 00 00 00 00 03 f0 a5 a5
				/* display on */
				05 01 00 00 00 00 01 29
				];
		oem,mdss-dsi-lpm-to-on-command-state = "dsi_hs_mode";
		oem,mdss-dsi-partial-window-en-command = [
				/* viewable region */
				39 01 00 00 00 00 05 30 00 00 00 00
				/* enter partial mode */
				05 01 00 00 00 00 01 12
				];
		oem,mdss-dsi-partial-window-sr-bytes = [09 08];
		oem,mdss-dsi-partial-window-er-bytes = [0b 0a];
		oem,mdss-dsi-partial-window-dis-command = [05 01 00 00 00 00 01 13];
		qcom,mdss-dsi-h-sync-pulse = <0>;
		qcom,mdss-dsi-traffic-mode = "non_burst_sync_event";
		qcom,mdss-dsi-lane-0-state;
		qcom,mdss-dsi-lane-1-state;
		qcom,mdss-dsi-lane-2-state;
		qcom,mdss-dsi-lane-3-state;
		qcom,mdss-dsi-te-pin-select = <1>;
		qcom,mdss-dsi-te-v-sync-rd-ptr-irq-line = <0x2c>;
		qcom,mdss-dsi-te-v-sync-continues-lines = <0x3c>;
		qcom,mdss-dsi-te-dcs-command = <1>;
		qcom,mdss-dsi-te-check-enable;
		qcom,mdss-dsi-te-using-te-pin;
		qcom,mdss-dsi-panel-timings = [F3 34 22 00 62 66 28 36 2B 03 04 00];
		qcom,mdss-dsi-t-clk-post = <0x03>;
		qcom,mdss-dsi-t-clk-pre = <0x25>;
		qcom,mdss-dsi-bl-pmic-control-type = "bl_ctrl_dcs";
		qcom,mdss-dsi-bl-min-level = <1>;
		qcom,mdss-dsi-bl-max-level = <255>;
		qcom,mdss-dsi-dma-trigger = "trigger_sw";
		qcom,mdss-dsi-mdp-trigger = "none";
		qcom,mdss-dsi-reset-sequence = <0 1>, <1 10>;
	};
};
